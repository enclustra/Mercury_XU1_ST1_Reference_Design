/include/ "system-conf.dtsi"
/ {
	model = "Enclustra ME-XU1-9EG-3E-D12E SOM";
};
#include "zynqmp_enclustra_common.dtsi"
#include "zynqmp_enclustra_mercury_xu1.dtsi"
#include "zynqmp_enclustra_mercury_st1.dtsi"
