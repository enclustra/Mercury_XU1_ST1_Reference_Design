/include/ "system-conf.dtsi"
/ {
	model = "Enclustra ME-XU1-15EG-2I-D12E-G1 SOM";
};
#include "zynqmp_enclustra_common.dtsi"
#include "zynqmp_enclustra_mercury_xu1.dtsi"
#include "zynqmp_enclustra_mercury_st1.dtsi"
